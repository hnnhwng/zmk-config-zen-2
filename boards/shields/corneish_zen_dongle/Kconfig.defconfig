## boards/shields/corneish_zen_dongle/Kconfig.defconfig
```kconfig
#
# Copyright (c) 2020 The ZMK Contributors
# SPDX-License-Identifier: MIT
#

if SHIELD_CORNEISH_ZEN_DONGLE

config ZMK_KEYBOARD_NAME
    default "Corne-ish Zen"

config ZMK_BLE
	default y

config ZMK_USB
	default y

config ZMK_SPLIT_ROLE_CENTRAL
    default y

config ZMK_SPLIT
	default y

config ZMK_SPLIT_BLE_CENTRAL_PERIPHERALS
	default 2

config ZMK_KSCAN_GPIO_DRIVER
	default y

endif # SHIELD_CORNEISH_ZEN_DONGLE
```
